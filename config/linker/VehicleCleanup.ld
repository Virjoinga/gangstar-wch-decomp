OUTPUT_FORMAT("elf32-littlearm")
OUTPUT_ARCH(arm)
INCLUDE build/matches/vehicle-cleanup/retail-symbols.ld
__cxa_guard_acquire = 0x001c4958;
__cxa_guard_release = 0x001c46c4;
__aeabi_atexit = 0x001c494c;
_Znwj = 0x001c4814;
atoi = 0x001c4880;
__stack_chk_fail = 0x001c42e0;
_ZN21GameFactoryProperties9billboardE = 0x004144b8;
_ZdlPv = 0x001c42b0;
strcmp = 0x001c4658;
puts = 0x001c41b4;
__aeabi_fcmpge = 0x001c4364;
__aeabi_fcmplt = 0x001c479c;
__aeabi_fdiv = 0x001c4520;
__aeabi_f2d = 0x001c48f8;
__aeabi_fmul = 0x001c4724;
__aeabi_fadd = 0x001c4154;
__aeabi_fsub = 0x001c4328;
SECTIONS
{
    .vehicle_yaw 0x0030949c : { *(.text._ZN7Vehicle4_yawEf) }
    .vehicle_roll 0x00309504 : { *(.text._ZN7Vehicle5_rollEf) }
    .vehicle_pitch 0x0030956c : { *(.text._ZN7Vehicle6_pitchEf) }
    .vehicle_setYaw 0x0030a054 : { *(.text._ZN7Vehicle7_setYawEf) }
    .vehicle_setRoll 0x0030a0d0 : { *(.text._ZN7Vehicle8_setRollEf) }
    .vehicle_setPitch 0x0030a14c : { *(.text._ZN7Vehicle9_setPitchEf) }
    .vehicle_adjust_traction 0x003099dc : { *(.text._ZN7Vehicle15_adjustTractionEP6b2Bodyf) }
    .vehicle_remove_wheel_collisions 0x0030a604 : { *(.text._ZN7Vehicle21removeWheelCollisionsEv) }
    .vehicle_load_explosion 0x00309044 : { *(.text._ZN7Vehicle13loadExplosionEPKc) }
    .EvVehicleDeactivated_d0 0x00310d7c : { *(.gnu.linkonce.t._ZN20EvVehicleDeactivatedD0Ev) }
    .EvVehicleDeactivated_d1 0x00310da8 : { *(.gnu.linkonce.t._ZN20EvVehicleDeactivatedD1Ev) }
    .EvVehicleDeactivated_vtable 0x004ab2b8 : { *(.gnu.linkonce.d.rel.ro._ZTV20EvVehicleDeactivated) }
    .EvVehicleDestroyed_d0 0x00311200 : { *(.gnu.linkonce.t._ZN18EvVehicleDestroyedD0Ev) }
    .EvVehicleDestroyed_d1 0x0031122c : { *(.gnu.linkonce.t._ZN18EvVehicleDestroyedD1Ev) }
    .EvVehicleDestroyed_vtable 0x004ab2d0 : { *(.gnu.linkonce.d.rel.ro._ZTV18EvVehicleDestroyed) }
    .vehicle_base_event_id 0x002d3c34 : { *(.gnu.linkonce.t._ZNK6IEvent10getEventIDEv) }
    .vehicle_base_event_delete 0x002d4074 : { *(.gnu.linkonce.t._ZN6IEventD0Ev) }
    .vehicle_base_event_dtor 0x002d4094 : { *(.gnu.linkonce.t._ZN6IEventD1Ev) }
    .vehicle_base_event_vtable 0x004a6198 : { *(.gnu.linkonce.d.rel.ro._ZTV6IEvent) }
    .custom_skin_transformed_bounds 0x00307fc4 : { *(.text._ZNK26CustomSkinnedMeshSceneNode25getTransformedBoundingBoxEv) }
    .vehicle_play_siren 0x00312020 : { *(.text._ZN7Vehicle9playSirenEv) }
    .vehicle_tag_for_kill 0x0030a8f4 : { *(.text._ZN7Vehicle10tagForKillEb) }
    .vehicle_enable 0x0030bb64 : { *(.text._ZN7Vehicle6enableEv) }
    .vehicle_initialize_driver 0x0030a8bc : { *(.text._ZN7Vehicle16initializeDriverEv) }
    .custom_skin_bounds 0x00307b00 : { *(.text._ZNK26CustomSkinnedMeshSceneNode14getBoundingBoxEv) }
    .car_morph_prepare 0x00309338 : { *(.text._ZN16CCarMorphingMesh27onPrepareBufferForRenderingEN3irr5scene12IColladaMesh21E_PREPARE_BUFFER_STEPEPNS0_5video12IVideoDriverEj) }
    .car_factory_create_node 0x0030a6a0 : { *(.text._ZN11CCarFactory10createNodeERKN3irr7collada16CColladaDatabaseEPNS1_5SNodeE) }
    .car_factory_singleton 0x003081b4 : { *(.gnu.linkonce.t._ZN11CCarFactory11getInstanceEv) }
    .car_factory_guard 0x004b672c (NOLOAD) : { *(.gnu.linkonce.b._ZGVZN11CCarFactory11getInstanceEvE2cf) }
    .car_factory_instance 0x004b8880 (NOLOAD) : { *(.gnu.linkonce.b._ZZN11CCarFactory11getInstanceEvE2cf) }
    .car_factory_delete 0x0030b5b0 : { *(.gnu.linkonce.t._ZN11CCarFactoryD0Ev) }
    .car_factory_destructor 0x0030b600 : { *(.gnu.linkonce.t._ZN11CCarFactoryD1Ev) }
    .car_factory_vtable 0x004ab2e8 : { *(.gnu.linkonce.d.rel.ro._ZTV11CCarFactory) }
    .vehicle_target_cleanup 0x00310880 : { *(.text._ZN7Vehicle22cleanupTargetDetectionEv) }
    .vehicle_clear_alert 0x003108d4 : { *(.text._ZN7Vehicle12clearOnAlertEv) }
    .vehicle_camera_enter 0x0030a378 : { *(.text._ZN7Vehicle13onCameraEnterEv) }
    .vehicle_percent_skid 0x00307d7c : { *(.text._ZN7Vehicle21_calculatePercentSkidEf) }
    .vehicle_marker_type 0x00307b9c : { *(.text._ZN7Vehicle13getMarkerTypeEv) }
    .vehicle_stop_siren 0x00308170 : { *(.text._ZN7Vehicle9stopSirenEv) }
    .vehicle_sound_register 0x003083a4 : { *(.text._ZN7Vehicle26RegisterCarSoundsCallbacksEv) }
    .vehicle_sound_unregister 0x00308398 : { *(.text._ZN7Vehicle28UnRegisterCarSoundsCallbacksEv) }
    .vehicle_get_speed 0x00307ba4 : { *(.text._ZNK7Vehicle8GetSpeedEv) }
    .vehicle_warm_up 0x0030a1c8 : { *(.text._ZN7Vehicle6WarmUpEv) }
    .vehicle_reset_previous_position 0x00309d2c : { *(.text._ZN7Vehicle16resetPreviousPosEv) }
    .vehicle_check_destination 0x00309428 : { *(.text._ZN7Vehicle16CheckDestinationEv) }
    .vehicle_flee 0x003093c4 : { *(.text._ZN7Vehicle4fleeERKN3irr4core8vector3dIfEE) }
    .vehicle_drive_to_location 0x003093f0 : { *(.text._ZN7Vehicle15driveToLocationERKN3irr4core8vector3dIfEEb) }
    .vehicle_wait 0x00307ed4 : { *(.text._ZN7Vehicle4waitEi) }
    .vehicle_freeze 0x00307f04 : { *(.text._ZN7Vehicle6freezeEv) }
    .vehicle_set_position 0x0030bc4c : { *(.text._ZN7Vehicle11SetPositionERKN3irr4core8vector3dIfEE) }
    .vehicle_set_rotation 0x0030b648 : { *(.text._ZN7Vehicle11SetRotationERKN3irr4core10quaternionE) }
    .vehicle_reset_state 0x00309dec : { *(.text._ZN7Vehicle12resetVehicleEv) }
    .vehicle_destroy_wheels 0x00309e68 : { *(.text._ZN7Vehicle13DestroyWheelsEv) }
    .vehicle_stop 0x00309eac : { *(.text._ZN7Vehicle4StopEv) }
    .vehicle_immobilize 0x0030a230 : { *(.text._ZN7Vehicle10immobilizeEv) }
    .vehicle_accelerate 0x00307d30 : { *(.text._ZN7Vehicle10accelerateEf) }
    .vehicle_brake 0x00307d48 : { *(.text._ZN7Vehicle5brakeEf) }
    .vehicle_turn 0x00307d60 : { *(.text._ZN7Vehicle4turnEbf) }
    .vehicle_set_driver 0x00308e48 : { *(.text._ZN7Vehicle9setDriverEP9Character) }
    .vehicle_reset_driver 0x0030a1fc : { *(.text._ZN7Vehicle11resetDriverEv) }
    .vehicle_reset_collisions 0x0030a5c4 : { *(.text._ZN7Vehicle15resetCollisionsEv) }
    .vehicle_skin_mesh 0x00307b18 : { *(.text._ZN7Vehicle11getSkinMeshEv) }
    .vehicle_get_spawn_type 0x00307b50 : { *(.text._ZN7Vehicle12getSpawnTypeEv) }
    .vehicle_set_spawn_type 0x00307b58 : { *(.text._ZN7Vehicle12setSpawnTypeEi) }
    .vehicle_get_max_health 0x00307b60 : { *(.text._ZNK7Vehicle12getMaxHealthEv) }
    .vehicle_get_health 0x00307b68 : { *(.text._ZNK7Vehicle9getHealthEv) }
    .vehicle_is_dead 0x00307b70 : { *(.text._ZN7Vehicle6isDeadEv) }
    .vehicle_post_explosion 0x0030a2ac : { *(.text._ZN7Vehicle13postExplosionEv) }
    .vehicle_explosion_callback 0x0030a2d0 : { *(.text._Z28VehicleExplosionAnimCallbackPN3irr5scene19ITimelineControllerEPv) }
    .vehicle_shot_reaction 0x00308e80 : { *(.text._ZN7Vehicle7shootedEiP11LevelObject) }
    .vehicle_apply_damage 0x0030a2e0 : { *(.text._ZN7Vehicle11applyDamageEiP11LevelObjectb) }
    .vehicle_photographed 0x00307b20 : { *(.text._ZN7Vehicle12photographedEv) }
    .vehicle_clear_photographed 0x00307b30 : { *(.text._ZN7Vehicle17clearPhotographedEv) }
    .vehicle_is_photographed 0x00307b44 : { *(.text._ZNK7Vehicle14isPhotographedEv) }
    .vehicle_show_wheels 0x00309078 : { *(.text._ZN7Vehicle10showWheelsEv) }
    .vehicle_hide_wheels 0x003090b0 : { *(.text._ZN7Vehicle10hideWheelsEv) }
    .vehicle_no_animators_message 0x0041f4b0 : { *(.rodata.*noAnimatorsMessage*) }
    .vehicle_no_timeline_message 0x0041f4d4 : { *(.rodata.*noTimelineMessage*) }
    .vehicle_no_callback_timeline_message 0x0041f4f0 : { *(.rodata.*noCallbackTimelineMessage*) }
    .vehicle_close_left_door_clip 0x0041f514 : { *(.rodata.*closeLeftDoorClip*) }
    .vehicle_close_right_door_clip 0x0041f528 : { *(.rodata.*closeRightDoorClip*) }
    .vehicle_exit_low_left_clip 0x0041f540 : { *(.rodata.*exitLowLeftClip*) }
    .vehicle_exit_low_right_clip 0x0041f558 : { *(.rodata.*exitLowRightClip*) }
    .vehicle_exit_high_left_clip 0x0041f570 : { *(.rodata.*exitHighLeftClip*) }
    .vehicle_exit_high_right_clip 0x0041f588 : { *(.rodata.*exitHighRightClip*) }
    .vehicle_closed_idle_clip 0x0041f5a0 : { *(.rodata.*closedIdleClip*) }
    .vehicle_opened_idle_clip 0x0041f5b0 : { *(.rodata.*openedIdleClip*) }
    .vehicle_animation_transition 0x003098ec : { *(.text._Z19aTransitionCallbackPN3irr5scene19ITimelineControllerEPv) }
    .vehicle_callback 0x003099a0 : { *(.text._Z15VehicleCallBackPN3irr5scene19ITimelineControllerEPv) }
    .vehicle_start_anim 0x003095d4 : { *(.text._ZN7Vehicle9startAnimEPN3irr5scene18ISceneNodeAnimatorEb) }
    .vehicle_is_current_anim 0x003097c4 : { *(.text._ZN7Vehicle13isCurrentAnimEPKc) }
    .vehicle_get_timeline 0x003097f4 : { *(.text._ZN7Vehicle11getTimelineEPN3irr5scene10ISceneNodeE) }
    .vehicle_play_current_anim 0x00309828 : { *(.text._ZN7Vehicle20playCurAnimFromStartEv) }
    .vehicle_set_transition_callback 0x00309854 : { *(.text._ZN7Vehicle21setTransitionCallbackEPN3irr5scene10ISceneNodeE) }
    .vehicle_set_anim 0x00309890 : { *(.text._ZN7Vehicle7setAnimEPKcbf) }
    .vehicle_mesh 0x00307bc8 : { *(.text._ZN7Vehicle7getMeshEv) }
    .vehicle_is_high_vehicle 0x00308ec4 : { *(.text._ZN7Vehicle11isHiVehicleEv) }
    .vehicle_high_enter_clip 0x0041df0c : { *(.rodata.*highVehicleEnterClip*) }
    .vehicle_low_enter_clip 0x0041def8 : { *(.rodata.*lowVehicleEnterClip*) }
    .vehicle_is_low_vehicle 0x00308ef0 : { *(.text._ZN7Vehicle12isLowVehicleEv) }
    .vehicle_get_seated_animation 0x00308f1c : { *(.text._ZN7Vehicle18getSeatedAnimationEv) }
    .vehicle_get_right_thrown_animation 0x00308f34 : { *(.text._ZN7Vehicle23getRightThrownAnimationEv) }
    .vehicle_get_left_thrown_animation 0x00308f4c : { *(.text._ZN7Vehicle22getLeftThrownAnimationEv) }
    .vehicle_get_right_throw_animation 0x00308f64 : { *(.text._ZN7Vehicle22getRightThrowAnimationEv) }
    .vehicle_get_left_throw_animation 0x00308f7c : { *(.text._ZN7Vehicle21getLeftThrowAnimationEv) }
    .vehicle_get_right_eject_animation 0x00308f94 : { *(.text._ZN7Vehicle22getRightEjectAnimationEv) }
    .vehicle_get_left_eject_animation 0x00308fa4 : { *(.text._ZN7Vehicle21getLeftEjectAnimationEv) }
    .vehicle_get_right_exit_animation 0x00308fb4 : { *(.text._ZN7Vehicle21getRightExitAnimationEv) }
    .vehicle_get_left_exit_animation 0x00308fcc : { *(.text._ZN7Vehicle20getLeftExitAnimationEv) }
    .vehicle_get_right_close_door_from_inside_animation 0x00308fe4 : { *(.text._ZN7Vehicle36getRightCloseDoorFromInsideAnimationEv) }
    .vehicle_get_left_close_door_from_inside_animation 0x00308ffc : { *(.text._ZN7Vehicle35getLeftCloseDoorFromInsideAnimationEv) }
    .vehicle_get_right_enter_animation 0x00309014 : { *(.text._ZN7Vehicle22getRightEnterAnimationEv) }
    .vehicle_get_left_enter_animation 0x0030902c : { *(.text._ZN7Vehicle21getLeftEnterAnimationEv) }
    .vehicle_set_door_anim 0x0030a52c : { *(.text._ZN7Vehicle11setDoorAnimEPKcb) }
    .vehicle_close_door 0x0030a58c : { *(.text._ZN7Vehicle9closeDoorEb) }
    .vehicle_mesh_bounds 0x003091e8 : { *(.text._ZNK7Vehicle18GetMeshBoundingBoxEPKN3irr5scene10ISceneNodeE) }
    .vehicle_skinning 0x00309170 : { *(.text._ZN7Vehicle14enableSkinningEb) }
    .vehicle_reset_lights 0x0030805c : { *(.text._ZN7Vehicle12_resetLightsEv) }
    .vehicle_rent 0x00308128 : { *(.text._ZN7Vehicle4rentEb) }
    .vehicle_backface_culling 0x00308044 : { *(.text._ZN7Vehicle21enableBackfaceCullingEb) }
    .vehicle_on_door_closed 0x003138d4 : { *(.text._ZN7Vehicle12onDoorClosedEv) }
    .vehicle_open_door_inside 0x003139f8 : { *(.text._ZN7Vehicle18openDoorFromInsideEb) }
    .vehicle_open_door 0x00313a7c : { *(.text._ZN7Vehicle8openDoorEb) }
    .vehicle_open_door_clip 0x0041dee8 : { *(.rodata.*openDoorClip*) }
    .vehicle_door_callback 0x00313954 : { *(.text._Z22doorTransitionCallbackPN3irr5scene19ITimelineControllerEPv) }
    .vehicle_close_door_clip 0x0041f704 : { *(.rodata.*closeDoorClip*) }
    .vehicle_exit_car_clip 0x0041f79c : { *(.rodata.*exitCarClip*) }
    .vehicle_left_door 0x00307e40 : { *(.text._ZNK7Vehicle10isLeftDoorEPKN3irr5scene10ISceneNodeE) }
    .vehicle_door_opened 0x00307e58 : { *(.text._ZNK7Vehicle12isDoorOpenedEb) }
    .vehicle_door_closed 0x00307e78 : { *(.text._ZNK7Vehicle12isDoorClosedEb) }
    .vehicle_door_anim 0x00307e94 : { *(.text._ZNK7Vehicle10isDoorAnimEPKcb) }
    .vehicle_shift_weight 0x00307e10 : { *(.text._ZN7Vehicle12_shiftWeightERN3irr4core8vector3dIfEEf) }
    .vehicle_enter_anim 0x00307e14 : { *(.text._ZNK7Vehicle12getEnterAnimEv) }
    .vehicle_exit_anim 0x00307e1c : { *(.text._ZNK7Vehicle11getExitAnimEv) }
    .vehicle_close_door_anim 0x00307e24 : { *(.text._ZNK7Vehicle16getCloseDoorAnimEv) }
    .vehicle_interior 0x00307e2c : { *(.text._ZN7Vehicle14toggleInteriorEb) }
    .vehicle_notify_targeted 0x00307f1c : { *(.text._ZN7Vehicle15_notifyTargetedEbP9Character) }
    .vehicle_add_turbo 0x00307f90 : { *(.text._ZN7Vehicle14AddTurboSoundsEv) }
    .vehicle_init_4cyl 0x00307f94 : { *(.text._ZN7Vehicle19Init4CylTurboSoundsEv) }
    .vehicle_init_superbike 0x00307f98 : { *(.text._ZN7Vehicle19InitSuperbikeSoundsEv) }
    .vehicle_init_v12 0x00307f9c : { *(.text._ZN7Vehicle24InitV12LamborghiniSoundsEv) }
    .vehicle_set_stolen 0x00307fa0 : { *(.text._ZN7Vehicle16setHasBeenStolenEv) }
    .vehicle_get_stolen 0x00307fac : { *(.text._ZN7Vehicle16getHasBeenStolenEv) }
    .vehicle_unique_id 0x00307fb4 : { *(.text._ZN7Vehicle11getUniqueIdEv) }
    .vehicle_get_path 0x00307f28 : { *(.text._ZNK7Vehicle15getPathToFollowEv) }
    .vehicle_set_waypoint 0x00307f30 : { *(.text._ZN7Vehicle18setCurrentWaypointEi) }
    .vehicle_get_waypoint 0x00307f38 : { *(.text._ZNK7Vehicle18getCurrentWaypointEv) }
    .vehicle_loop_path 0x00307f40 : { *(.text._ZN7Vehicle16loopPathToFollowEb) }
    .vehicle_set_path 0x00307f68 : { *(.text._ZN7Vehicle15setPathToFollowEPK4Path) }
    .vehicle_is_looping 0x00307f84 : { *(.text._ZNK7Vehicle23isLoopingOnPathToFollowEv) }
    .vehicle_cleanup_0 0x00308014 : { *vehicle-cleanup.o(.text.__tcf_4) }
    .vehicle_cleanup_1 0x00308210 : { *vehicle-cleanup.o(.text.__tcf_3) }
    .vehicle_cleanup_2 0x0030b5dc : { *vehicle-cleanup.o(.text.__tcf_1) }
    .vehicle_cleanup_3 0x0030b624 : { *vehicle-cleanup.o(.text.__tcf_0) }
    .vehicle_empty_string 0x004b8724 (NOLOAD) : { *vehicle-cleanup.o(.bss._ZN3irr5scene6quake315irrEmptyStringcE) }
    .got 0x004b0048 : { *(.got.plt) . = 0x360; *(.got) }
    .verification 0x00600000 : { *retail-got.o(.text) }
}
ASSERT(SIZEOF(.vehicle_empty_string) == 32, "Vehicle empty string extent");
